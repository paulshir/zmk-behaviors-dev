## Kconfig
```kconfig
DT_COMPAT_ZMK_BEHAVIOR_STARTUP_LAYERS := zmk,behavior-startup-layers

config ZMK_BEHAVIOR_STARTUP_LAYERS
		bool
		default $(dt_compat_enabled,$(DT_COMPAT_ZMK_BEHAVIOR_STARTUP_LAYERS))
```

## dts/bindings/behaviors/zmk,behavior-startup-layers.yaml
```yaml
# Copyright (c) 2024 The ZMK Contributors
# SPDX-License-Identifier: MIT

description: Set startup layers

compatible: "zmk,behavior-startup-layers"

include: zero_param.yaml
properties:
  startup-layers-list:
    type: array
    required: true
```
